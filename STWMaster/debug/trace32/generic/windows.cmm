// T32 Fri Aug 14 08:45:09 2015

 B::
 
 TOOLBAR ON
 STATUSBAR ON
 FramePOS 2.75,1.5714,,,Maximized
 WinPAGE.RESet
 
 WinPAGE.Create P000
 
 WinCLEAR
 WinPOS 0.5 25.786 67. 23. 0. 0. W002
 Var.Local
 
 WinPOS 0.5 0.28571 67. 22. 0. 0. W001
 Register /spotlight
 
 WinPOS 71.0 0.071429 101. 47. 11. 1. W000
 WinTABS 10. 10. 25. 62.
 data.list
 
 WinPAGE.select P000
 
 ENDDO
